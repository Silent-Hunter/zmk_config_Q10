## config/west.yml
```yaml
manifest:
  remotes:
    - name: zmkfirmware
      url-base: https://github.com/zmkfirmware
  projects:
    - name: zmk
      remote: ZitaoTech
      revision: v0.3.0
      import: app/west.yml
  self:
    path: config
```
